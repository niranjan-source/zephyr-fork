## dts/bindings/interrupt-controller/nxp,lpc84x-pint.yaml
```yaml
# Copyright (c) 2026 Aerlync Labs Inc.
# SPDX-License-Identifier: Apache-2.0

description: "nxp,lpc84x-pint"

include: [base.yaml, interrupt-controller.yaml]

properties:
  reg:
    required: true

  interrupts:
    required: true
```
